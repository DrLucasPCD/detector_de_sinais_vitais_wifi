## firmware/esp32-s3-node/main/Kconfig.projbuild
```kconfig
menu "RF Sense"

config RF_WIFI_SSID
    string "SSID da rede 2,4 GHz"
    default ""

config RF_WIFI_PASSWORD
    string "Senha da rede"
    default ""

config RF_NODE_ID
    int "Identificador do nó"
    range 0 255
    default 1

config RF_HOSTNAME
    string "Hostname mDNS sem .local"
    default "rf-sense"

config RF_STREAM_FPS
    int "Limite de quadros CSI por segundo"
    range 5 50
    default 20

config RF_UDP_ENABLED
    bool "Enviar wire v1 também por UDP"
    default n

config RF_UDP_TARGET_IP
    string "IP do agregador UDP"
    depends on RF_UDP_ENABLED
    default "192.168.1.100"

config RF_UDP_TARGET_PORT
    int "Porta do agregador UDP"
    depends on RF_UDP_ENABLED
    range 1 65535
    default 5005

config RF_DISPLAY_ENABLED
    bool "Display (não usar na DevKitC sem display)"
    default n

endmenu
```

## firmware/esp32-s3-node/sdkconfig.defaults
```kconfig
CONFIG_ESPTOOLPY_FLASHSIZE_8MB=y
CONFIG_PARTITION_TABLE_CUSTOM=y
CONFIG_PARTITION_TABLE_CUSTOM_FILENAME="partitions.csv"
CONFIG_ESP_WIFI_CSI_ENABLED=y
CONFIG_HTTPD_WS_SUPPORT=y
CONFIG_HTTPD_MAX_REQ_HDR_LEN=1024
CONFIG_HTTPD_MAX_URI_LEN=256
CONFIG_ESP_WIFI_STATIC_RX_BUFFER_NUM=16
CONFIG_ESP_WIFI_DYNAMIC_RX_BUFFER_NUM=32
CONFIG_ESP_WIFI_RX_BA_WIN=16
CONFIG_LWIP_MAX_SOCKETS=16
CONFIG_COMPILER_OPTIMIZATION_PERF=y
```
